## boards/arm/eyelash_sofle/kconfig.shield
```kconfig
# No whitespace after the comma or in the keyboard name!
config eyelash_sofle_DONGLE
    def_bool $(shields_list_contains,eyelash_sofle_dongle)
```
